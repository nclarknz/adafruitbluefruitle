## Config.in
```kconfig
config BR2_PACKAGE_PYTHON_ADAFRUITBLUEFRUITLE
	bool "python-adafruitbluefruitle"
	help
	  The PyBluez module allows Python code to access the host machine's Bluetooth resources. It supports scanning for devices and opening bluetooth sockets (via native sockets on win/linux)

	  https://github.com/ndsitnz/adafruitbluefruitle
```
